/dts-v1/;
/plugin/;

// SPDX-License-Identifier: (GPL-2.0+ OR MIT)
/*
 * Copyright 2026 EPC Power
 *
 * Device tree overlay for EPC Power MOAB gen1 rev1
 * 
 * Part Number: 44-100131
 * Affected Revision: rev1
 *
 * If there are hardware changes made in newer board revisions that affect
 * device trees, you can add them here to maintain software compatibility
 * with older hardware revisions.
 * 
 * If a peripheral does not exist in the hardware that is targeted by this
 * overlay, you should prefer disabling the node instead of deleting it
 * to preserve compatibility with other overlays.
 */

// Part MCP7940NT-E/MS replaced pcf85363 in MOAB gen2 rev1
&{/soc@0/bus@30800000/i2c@30a30000/rtc@6f} {
    status = "disabled";
};

// ADC with 0x48 address was added in MOAB gen2 rev1
&{/soc@0/bus@30800000/i2c@30a30000/adc@48} {
    status = "disabled";
};

&i2c2 {
    #address-cells = <1>;
    #size-cells = <0>;

	/* Real-Time Clock (RTC) with 3V3 backup battery */
	rtc: rtc@51 {
		compatible = "nxp,pcf85363";
		reg = <0x51>;
    };
};